/*
  ST-LAB v2.0 (ESP32) - Example Code (Thai Commented)  // คำสั่ง/การตั้งค่าในโปรแกรม
  หมายเหตุ:  // คำสั่ง/การตั้งค่าในโปรแกรม
  - กรุณาแก้ค่า WiFi / Broker / Server ให้ตรงกับหน้างานก่อนใช้งานจริง  // คำสั่ง/การตั้งค่าในโปรแกรม
  - ผังขา (GPIO) ยึดตามสเปกที่ล็อกไว้ในเอกสารประกอบการสอน  // คำสั่ง/การตั้งค่าในโปรแกรม
*/


#include <LedControl.h>  // เรียกใช้งานไลบรารีที่จำเป็น
#include <DHT.h>  // เรียกใช้งานไลบรารีที่จำเป็น

#define MAX_DIN   23  // กำหนดค่าคงที่/ชื่อพินเพื่อใช้งานสะดวก
#define MAX_LOAD   5  // กำหนดค่าคงที่/ชื่อพินเพื่อใช้งานสะดวก
#define MAX_CLK   18  // กำหนดค่าคงที่/ชื่อพินเพื่อใช้งานสะดวก

#define DHT_PIN 32  // กำหนดค่าคงที่/ชื่อพินเพื่อใช้งานสะดวก
#define DHT_TYPE DHT11  // กำหนดค่าคงที่/ชื่อพินเพื่อใช้งานสะดวก
DHT dht(DHT_PIN, DHT_TYPE);  // คำสั่ง/การตั้งค่าในโปรแกรม

LedControl lc = LedControl(MAX_DIN, MAX_CLK, MAX_LOAD, 1);  // คำสั่ง/การตั้งค่าในโปรแกรม

static const byte SEG_A = 0x01;  // คำสั่ง/การตั้งค่าในโปรแกรม
static const byte SEG_B = 0x02;  // คำสั่ง/การตั้งค่าในโปรแกรม
static const byte SEG_C = 0x04;  // คำสั่ง/การตั้งค่าในโปรแกรม

enum Mode {  // คำสั่ง/การตั้งค่าในโปรแกรม
  MODE_NUMBER = 0,  // คำสั่ง/การตั้งค่าในโปรแกรม
  MODE_CLOCK  = 1,  // คำสั่ง/การตั้งค่าในโปรแกรม
  MODE_TEMP   = 2  // คำสั่ง/การตั้งค่าในโปรแกรม
};  // ขอบเขตบล็อกคำสั่ง

Mode mode = MODE_NUMBER;  // คำสั่ง/การตั้งค่าในโปรแกรม

void setup() {  // ฟังก์ชันเริ่มต้น ทำงานครั้งเดียวเมื่อบอร์ดเริ่มทำงาน
  Serial.begin(115200);  // เริ่มต้นพอร์ต Serial สำหรับดีบัก
  dht.begin();  // อ่านค่า/เริ่มต้นเซนเซอร์ DHT11

  lc.shutdown(0, false);  // สั่งงาน MAX7219 ผ่านไลบรารี LedControl
  lc.setIntensity(0, 8);  // สั่งงาน MAX7219 ผ่านไลบรารี LedControl
  lc.clearDisplay(0);  // สั่งงาน MAX7219 ผ่านไลบรารี LedControl

  Serial.println("LAB10: MAX7219 Started");  // คำสั่ง/การตั้งค่าในโปรแกรม
}  // ขอบเขตบล็อกคำสั่ง

void show4DigitNumber(int value) {  // คำสั่ง/การตั้งค่าในโปรแกรม
  value = constrain(value, 0, 9999);  // คำสั่ง/การตั้งค่าในโปรแกรม
  int d0 = (value / 1000) % 10;  // คำสั่ง/การตั้งค่าในโปรแกรม
  int d1 = (value / 100) % 10;  // คำสั่ง/การตั้งค่าในโปรแกรม
  int d2 = (value / 10) % 10;  // คำสั่ง/การตั้งค่าในโปรแกรม
  int d3 = value % 10;  // คำสั่ง/การตั้งค่าในโปรแกรม

  lc.setDigit(0, 0, d0, false);  // สั่งงาน MAX7219 ผ่านไลบรารี LedControl
  lc.setDigit(0, 1, d1, false);  // สั่งงาน MAX7219 ผ่านไลบรารี LedControl
  lc.setDigit(0, 2, d2, false);  // สั่งงาน MAX7219 ผ่านไลบรารี LedControl
  lc.setDigit(0, 3, d3, false);  // สั่งงาน MAX7219 ผ่านไลบรารี LedControl
}  // ขอบเขตบล็อกคำสั่ง

void setColon(bool on) {  // คำสั่ง/การตั้งค่าในโปรแกรม
  byte seg = on ? (SEG_A | SEG_B) : 0x00;  // คำสั่ง/การตั้งค่าในโปรแกรม
  lc.setRow(0, 4, seg);  // สั่งงาน MAX7219 ผ่านไลบรารี LedControl
}  // ขอบเขตบล็อกคำสั่ง

void setDegreeDot(bool on) {  // คำสั่ง/การตั้งค่าในโปรแกรม
  byte seg = on ? SEG_C : 0x00;  // คำสั่ง/การตั้งค่าในโปรแกรม
  lc.setRow(0, 4, seg);  // สั่งงาน MAX7219 ผ่านไลบรารี LedControl
}  // ขอบเขตบล็อกคำสั่ง

void loop() {  // ฟังก์ชันหลัก ทำงานวนซ้ำตลอดเวลา
  static unsigned long lastSwitch = 0;  // คำสั่ง/การตั้งค่าในโปรแกรม
  if (millis() - lastSwitch > 10000) {  // ตรวจสอบเงื่อนไขการทำงาน
    lastSwitch = millis();  // คำสั่ง/การตั้งค่าในโปรแกรม
    mode = (Mode)((mode + 1) % 3);  // คำสั่ง/การตั้งค่าในโปรแกรม
    lc.clearDisplay(0);  // สั่งงาน MAX7219 ผ่านไลบรารี LedControl
  }  // ขอบเขตบล็อกคำสั่ง

  if (mode == MODE_NUMBER) {  // ตรวจสอบเงื่อนไขการทำงาน
    static int n = 0;  // คำสั่ง/การตั้งค่าในโปรแกรม
    show4DigitNumber(n);  // คำสั่ง/การตั้งค่าในโปรแกรม
    setColon(false);  // คำสั่ง/การตั้งค่าในโปรแกรม
    n = (n + 1) % 10000;  // คำสั่ง/การตั้งค่าในโปรแกรม
    delay(50);  // หน่วงเวลา (มิลลิวินาที)
  }  // ขอบเขตบล็อกคำสั่ง
  else if (mode == MODE_CLOCK) {  // ทางเลือกเมื่อเงื่อนไขไม่เป็นจริง
    static int hh = 12, mm = 0;  // คำสั่ง/การตั้งค่าในโปรแกรม
    static unsigned long lastTick = 0;  // คำสั่ง/การตั้งค่าในโปรแกรม

    if (millis() - lastTick >= 1000) {  // ตรวจสอบเงื่อนไขการทำงาน
      lastTick += 1000;  // คำสั่ง/การตั้งค่าในโปรแกรม
      mm++;  // คำสั่ง/การตั้งค่าในโปรแกรม
      if (mm >= 60) { mm = 0; hh = (hh + 1) % 24; }  // ตรวจสอบเงื่อนไขการทำงาน
    }  // ขอบเขตบล็อกคำสั่ง

    int value = (hh * 100) + mm;  // คำสั่ง/การตั้งค่าในโปรแกรม
    show4DigitNumber(value);  // คำสั่ง/การตั้งค่าในโปรแกรม
    setColon((millis() / 500) % 2);  // คำสั่ง/การตั้งค่าในโปรแกรม
    delay(20);  // หน่วงเวลา (มิลลิวินาที)
  }  // ขอบเขตบล็อกคำสั่ง
  else if (mode == MODE_TEMP) {  // ทางเลือกเมื่อเงื่อนไขไม่เป็นจริง
    float t = dht.readTemperature();  // อ่านค่า/เริ่มต้นเซนเซอร์ DHT11
    if (isnan(t)) {  // ตรวจสอบเงื่อนไขการทำงาน
      show4DigitNumber(0);  // คำสั่ง/การตั้งค่าในโปรแกรม
      setDegreeDot(false);  // คำสั่ง/การตั้งค่าในโปรแกรม
      delay(500);  // หน่วงเวลา (มิลลิวินาที)
      return;  // ออกจากฟังก์ชัน/ส่งค่ากลับ
    }  // ขอบเขตบล็อกคำสั่ง

    int ti = (int)(t * 10.0f);  // คำสั่ง/การตั้งค่าในโปรแกรม
    show4DigitNumber(ti);  // คำสั่ง/การตั้งค่าในโปรแกรม
    setDegreeDot(true);  // คำสั่ง/การตั้งค่าในโปรแกรม
    delay(500);  // หน่วงเวลา (มิลลิวินาที)
  }  // ขอบเขตบล็อกคำสั่ง
}  // ขอบเขตบล็อกคำสั่ง
